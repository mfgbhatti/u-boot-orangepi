## configs/t95_h616_2gb_x-v2_defconfig
```kconfig
CONFIG_ARM=y
CONFIG_ARCH_SUNXI=y
CONFIG_MACH_SUN50IW9=y
CONFIG_DEFAULT_DEVICE_TREE="t95-h616-2gb-x"
CONFIG_CONSOLE_MUX=y
CONFIG_OF_BOARD=y
CONFIG_SYS_TEXT_BASE=0x4A000000

#system
CONFIG_ARM_SMCCC=y
CONFIG_SUNXI_DMA=y
CONFIG_PHYS_64BIT=y
CONFIG_CMD_DHCP=y
CONFIG_CMD_PXE=y
CONFIG_EXT4_WRITE=y
CONFIG_CMD_EXT4_WRITE=y
CONFIG_ENV_IS_IN_FAT=y
#
# I2C support
#
CONFIG_I2C=y
CONFIG_I2C_BOARDINFO=y
CONFIG_I2C_CHARDEV=y
CONFIG_I2C_MUX=y
CONFIG_I2C_SMBUS=y
CONFIG_SYS_I2C_SUNXI=y
CONFIG_VIDEO_IR_I2C=y
CONFIG_MFD_AXP2101=y
CONFIG_MFD_AXP2101_I2C=y
#
# Power management options
#
CONFIG_SUNXI_POWER=y
CONFIG_SUNXI_PMU=y
CONFIG_POWER_SUPPLY=y
CONFIG_MFD_AXP2101=y
CONFIG_MFD_AXP2101_I2C=y
CONFIG_REGULATOR_AXP2101=y
CONFIG_SUNXI_REGULATOR_DT=y
#
# MMC/SD/SDIO Card Drivers
#
CONFIG_SUNXI_SDMMC=y
CONFIG_MMC=y
CONFIG_PWRSEQ_EMMC=y
CONFIG_PWRSEQ_SIMPLE=y
CONFIG_MMC_BLOCK=y
CONFIG_MMC_BLOCK_MINORS=16
CONFIG_MMC_BLOCK_BOUNCE=y
CONFIG_SUNXI_FLASH=y
CONFIG_SUNXI_NAND=y
#
# USB Peripheral Controller
#
CONFIG_USB_SUNXI_UDC0=y
CONFIG_SUNXI_USB=y
CONFIG_USB_SUNXI_USB=y
CONFIG_USB_SUNXI_USB_MANAGER=y
CONFIG_USB_SUNXI_USB_DEBUG=y
CONFIG_USB_SUNXI_USB_ADB=y
#
# Partition Types
#
CONFIG_EFI_PARTITION=y
#
# Clock
#
CONFIG_CLK_SUNXI=y
#
# BOOT GUI
#
CONFIG_BOOT_GUI=y
CONFIG_LZMA=y
CONFIG_DISP2_SUNXI=y
CONFIG_HDMI2_DISP2_SUNXI=y
CONFIG_TV_DISP2_SUNXI=y
# CONFIG_PWM_SUNXI is not set
CONFIG_PWM_SUNXI_NEW=y
```
